## examples/qemu-riscv-virt-nuttx/app/Kconfig
```kconfig
#
# For a description of the syntax of this configuration file,
# see the file kconfig-language.txt in the NuttX tools repository.
#

menuconfig DEMO_APP
	tristate "Demo App rtmlib"
	default n
	---help---
		Enable the Demo App rtmlib.
```

## tests/os/nuttx/riscv/unittests/monitorapp/Kconfig
```kconfig
#
# For a description of the syntax of this configuration file,
# see the file kconfig-language.txt in the NuttX tools repository.
#

menuconfig DEMO_MONITOR_APP
	tristate "Demo Monitor App rtmlib"
	default n
	---help---
		Enable the Demo Monitor App rtmlib.
```
